## boards/shields/janus/Kconfig.defconfig
```kconfig
if SHIELD_JANUS_LEFT

config ZMK_KEYBOARD_NAME
    default "Janus"

config ZMK_SPLIT_ROLE_CENTRAL
    default y

endif

if SHIELD_JANUS_LEFT || SHIELD_JANUS_RIGHT

config ZMK_SPLIT
    default y

endif
```

## boards/shields/janus/Kconfig.shield
```kconfig
config SHIELD_JANUS_LEFT
    def_bool $(shields_list_contains,janus_left)

config SHIELD_JANUS_RIGHT
    def_bool $(shields_list_contains,janus_right)
```
